## config/boards/shields/Iguvine/Kconfig.defconfig
```kconfig
if SHIELD_IGUVINE_LEFT
    
config ZMK_SPLIT_ROLE_CENTRAL
    default y

endif

if SHIELD_IGUVINE_LEFT || SHIELD_IGUVINE_RIGHT

config ZMK_SPLIT
    default y

endif
```

## config/boards/shields/Iguvine/Kconfig.shield
```kconfig
config SHIELD_IGUVINE_LEFT
    def_bool $(shields_list_contains,iguvine_left)

config SHIELD_IGUVINE_RIGHT
    def_bool $(shields_list_contains,iguvine_right)
```
